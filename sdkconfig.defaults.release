## sdkconfig.defaults.release
```kconfig
#
# Log Level
#
CONFIG_LOG_DEFAULT_LEVEL_NONE=y
# CONFIG_LOG_DEFAULT_LEVEL_INFO is not set
CONFIG_LOG_DEFAULT_LEVEL=0
CONFIG_LOG_MAXIMUM_EQUALS_DEFAULT=y
CONFIG_LOG_MAXIMUM_LEVEL=0

#
# Level Settings
#
CONFIG_LOG_MASTER_LEVEL=y


#
# MPU driver
#
# CONFIG_MPU_LOG_LEVEL_DEFAULT is not set
CONFIG_MPU_LOG_LEVEL_NONE=y
CONFIG_MPU_LOG_LEVEL=0
```
